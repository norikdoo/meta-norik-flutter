## conf/distro/ampliphy-weston-wayland.conf
```bitbake
require conf/distro/ampliphy-wayland.conf

DISTRO = "ampliphy-weston-wayland"
DISTRO_NAME = "ampliPHY Weston Wayland (Phytec Weston Wayland Distribution)"

DISTRO_FEATURES:append = " pam"
```

## conf/layer.conf
```bitbake
# We have a conf and classes directory, add to BBPATH
BBPATH .= ":${LAYERDIR}"

# We have recipes-* directories, add to BBFILES
BBFILES += "${LAYERDIR}/recipes-*/*/*.bb \
            ${LAYERDIR}/recipes-*/*/*.bbappend"

BBFILE_COLLECTIONS += "meta-norik-flutter"
BBFILE_PATTERN_meta-norik-flutter = "^${LAYERDIR}/"
BBFILE_PRIORITY_meta-norik-flutter = "6"

LAYERDEPENDS_meta-norik-flutter = "core ampliphy meta-flutter"
LAYERSERIES_COMPAT_meta-norik-flutter = "kirkstone"
```
